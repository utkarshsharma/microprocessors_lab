	org 00h
	ljmp main
	USING 0

	org 50h
main:
	MOV TMOD,#001h		;16 bit counter mode

	LCALL read
	MOV DPTR, #DATA1

loop:
	MOV A,R7
	MOVC A, @A+DPTR		;READING FROM DATA1 USING INDEX
	MOV R4,A				;LSB
	MOV A, R7
	INC A
	INC R7
	MOVC A, @A+DPTR
	MOV R3,A		;MSB
;THE FUNCTION twoscomp TAKES TWO BYTES AS INPUT IN R3(MSB) ad R4(LSB)
	LCALL twoscomp
;THE FUNCTION twoscomp RETURNS THE 2's COMPLIMENTS OF THE TWO BYTES IN R3(MSB) ad R4(LSB)

;ENABLE INTERRUPT FOR T0
	SETB	ET0
	SETB	EA

;SET FREQUENCY FOR SQUARE WAVE
	MOV TH0,R3
	MOV TL0,R4
	SETB TR0
	SETB P1.7

sq_wave:
	SJMP sq_wave		;KEEP WAITING HERE AS INTERRUPT DOES IT'S JOB.


	org 2000h
read:
	PUSH AR0			;PUSH R0 ONTO THE STACK
	PUSH ACC			;PUSH A ONTO THE STACK
	MOV P1,#00FH		;clearing first 4 bits in advance to make last 4 bits of memory location 0

;READ TWICE WITHOUT DELAY
	MOV A,P1
	MOV R0,A

	MOV A,P1

	SUBB A,R0			; check if both values read are equal
	CJNE A,#000H,read

;NEXT PART OF CODE DOUBLES THE INDEX READ FROM THE SWITCH
	MOV B,#002H
	MOV A,R0
	MUL AB
	MOV R7,A			;FROM HERE ONWARDS R7 STORES OUR INDEX 
	POP ACC				;POP A BACK FROM THE STACK AFTER SUBROUTINE IS COMPLETED
	POP AR0				;POP R0 BACK FROM THE STACK AFTER SUBROUTINE IS COMPLETED
	RET

twoscomp:			;take bit-by-bitcomplement and add 1
	PUSH ACC
	MOV A,R4			;LSB
	CPL A
	CLR C
	ADD A,#1
	MOV R4,A
	MOV A,R3			;MSB
	CPL A 

	JC carry			;if carry from LSB, jump to carry
	MOV R3,A			;otherwise, take complement directly
	pop ACC
	RET

carry:
	ADD A,#1			;adding carry 1 to complement
	MOV R3,A
	POP ACC
	RET

;INTERRUPT ROUTINE FOR TIMER0
	org 000Bh
ISR:
	CLR		TR0				;STOP T0 FROM OVERFLOWING AGAIN BEFORE P0.7 IS INVERTED								
	MOV		TH0,R4			;RESET TH0 AND TL0 FROM VALUE OF FREQ STORED AT R3 AND R4			
	MOV		TL0,R3
	CPL		P1.7
	SETB	TR0				;START T0 AGAIN					
	RETI

;DATA STORED IN EXTERNAL MEMORY LOCATIONS
	org 5000h
DATA1:
	DB 1AH, 11H, 24H, 10H, 3CH, 0FH, 61H, 0EH, 93H, 0DH, 0CFH, 0CH, 17H, 0CH, 6AH, 0BH, 0C6H, 0AH, 2BH, 0AH, 99H, 09H, 0FH, 09H, 8DH, 08H, 12H, 08H, 9EH, 07H, 31H, 07H

	END