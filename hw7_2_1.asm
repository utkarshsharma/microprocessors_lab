ORG 000H
SPCON EQU 00C3H ;TO SET BAUD RATE, CLOCK POLARITY, ETC
SPIF EQU 00C4H ;SERIAL PERIPHERAL DATA TRANSFER FLAG
DATAREGISTER EQU 0C5H
LJMP MAIN
ORG 0AF0H

MAIN:
	MOV SPCON, #01011101B ;BAUD RATE = 3MHz	
	
INITIALIZE:
	CLR P0.0
	MOV DATAREGISTER, #00000001B
	
CHECK:
	MOV B, SPIF 
	JNB B.7, CHECK
	MOV DATAREGISTER, #10000000B
	
CHECK2:
	MOV B, SPIF
	JNB B.7, CHECK2
	
	MOV B, DATAREGISTER
	ANL B, #00000011B
	MOV A, B
	RL A
	RL A
	MOV 20H, #00110000B
	ORL A, 20H
	MOV 20H, A
	
	MOV DATAREGISTER, #00H
	
CHECK3:
	MOV B, SPIF
	JNB B.7, CHECK3
	MOV B, DATAREGISTER
	MOV A, B
	ANL A, #11000000B
	RL A
	RL A
	MOV B, A
	CLR B.1
	CLR B.0
	MOV 21H, B
	
	SETB P0.0
	CLR P0.1
	MOV DATAREGISTER, 20H
	
CHECK4:
	MOV B, SPIF
	JNB B.7, CHECK4
	MOV DATAREGISTER, 21H
	
CHECK5:
	MOV B, SPIF
	JNB B.7, CHECK5
	
LJMP INITIALIZE

END
	

	
	
	
END