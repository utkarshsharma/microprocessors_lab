SPCON EQU 0C3H
SPSTA EQU 0C4H
SPDAT EQU 0C5H


org 000H 
ljmp MAIN
org 0100H 

MAIN:
	SETB P2.1			;DACEnable
	SETB P2.2			;ADCEnable
	CLR P2.0			;LDAC
	MOV SPCON,#01111101B;BaudRate=3MHz
	MOV R0,#01110000B
	MOV R1,#000H
		
LOOPINC:		
	CLR P2.1
	MOV SPDAT,R0
	SPIF1:
	MOV A,SPSTA
	JNB ACC.7,SPIF1
	MOV SPDAT,R1
	SPIF2:
	MOV A,SPSTA
	JNB ACC.7,SPIF2
	SETB P2.1
	lcall delaysub
	
	INC R0
	CJNE R0,#01111111b,LOOPINC
	lcall delaysub
	
LOOPDEC:	
	MOV R1,#000H
	DEC R0
	CLR P2.1
	MOV SPDAT,R0
	SPIF3:
	MOV A,SPSTA
	JNB ACC.7,SPIF3
	MOV SPDAT,R1
	SPIF4:
	MOV A,SPSTA
	JNB ACC.7,SPIF4
	SETB P2.1
	lcall delaysub
	
	CJNE R0,#01110000B,LOOPDEC
	ljmp MAIN
		
delaysub:						;0.5/8ms
	MOV R4,#010H
	delay:
	DJNZ R4,delay
	ret
			
end		