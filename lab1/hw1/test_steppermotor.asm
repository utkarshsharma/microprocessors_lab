ORG 00h
USING 0
LJMP setup

	ORG 100H	
setup:
	MOV TMOD, #001h
	SETB ET0			;ENABLE INTERRUPTS FOR T1 AND T0
	SETB EA
	MOV R5, #01H
	
MAIN:
MOV DPTR, #speed
MOV A, #00h
MOV R7, #00H
run:
MOV A, R7
MOVC A, @A+DPTR
SWAP A
MOV P0, A
INC R7
runrun:
LCALL hundredfiftyms
DJNZ R5, runrun
MOV R5, #010H
CJNE R7, #004h, run
LJMP MAIN
	
	
	PREV_UP_HIGH_D_LOW:
	SETB P1.0
	CLR P1.1
	JB P1.0, S1
	JNB P1.0,C1
C1: LCALL UBP
	LJMP PREV_UP_LOW_D_LOW
S1:	JNB P1.1, PREV_UP_HIGH_D_LOW
	JB P1.1, C2
C2: LCALL DBP
	LJMP PREV_UP_HIGH_D_HIGH
	
	PREV_UP_LOW_D_HIGH:
	CLR P1.0
	SETB P1.1
	JNB P1.0, S2
	JB P1.0,C3
C3: LCALL UBP
	LJMP PREV_UP_HIGH_D_HIGH
S2:	JB P1.1, PREV_UP_HIGH_D_LOW
	JNB P1.1, C4
C4: LCALL DBP
	LJMP PREV_UP_LOW_D_LOW
	
	PREV_UP_HIGH_D_HIGH:
	SETB P1.0
	SETB P1.1
	JB P1.0, S3
	JNB P1.0,C5
C5: LCALL UBP
	LJMP PREV_UP_LOW_D_HIGH
S3:	JB P1.1, PREV_UP_HIGH_D_LOW
	JNB P1.1, C6
C6: LCALL DBP
	LJMP PREV_UP_HIGH_D_LOW
	
	PREV_UP_LOW_D_LOW:
	CLR P1.0
	CLR P1.1
	JNB P1.0,S4
	JB P1.0, C7
C7: LCALL UBP
	LJMP PREV_UP_HIGH_D_LOW
S4:	JNB P1.1, PREV_UP_HIGH_D_LOW
	JB P1.1, C8
C8: LCALL DBP
	LJMP PREV_UP_LOW_D_HIGH
	
UBP:
	CJNE	R6,		#07H, 	STEPUP
STEPUP:
	LCALL INCREASE
	RET
	
	DBP:
	CJNE	R6,		#0F9H, 	STEPDOWN
STEPDOWN:
	LCALL DECREASE
	RET
	
	INCREASE:
	INC		R6
	RET
	
	DECREASE:
	DEC 	R6
	RET

speed:
DB 08H, 04H, 02H, 01H, 08H, 04H


ORG 1500H
hundredfiftyms:
	PUSH AR1
	PUSH AR2
;MOVING 00 TO TH0 AND TL0
	MOV TH0, #00h	
	MOV TL0, #00h

	SETB TR0					;START TIMER1. STOPS ONLY WHEN 100ms ARE COMPLETED. THIS GIVES US ONE 100ms LOOP.
	MOV R2, #06h					;NO. OF TIMES WE HAVE TO RUN T0 FROM 00 TO FE FOR 100ms
set_t1_again:
	DJNZ R2, t1loop					;CHECKING IF 100ms ARE DONE
	sjmp hundfifms_done
t1loop:
;RESET TH0 AND TL0 if 100ms NOT UP
	MOV TH0, #00h
	MOV TL0, #00h
;CHECK TH0 AND STOP IT FROM OVERFLOWING BECAUSE 100ms ARE NOT UP
check_th1:
	MOV R1, TH0
	CJNE R1, #0feh, check_th1
	SJMP set_t1_again
;NOW 100ms ALMOST DONE. WAIT FOR INTERRUPT0 TO BE CALLED. THAT IS, TR0 TO BECOME 0.
hundfifms_done:
	CLR C
	MOV C, TR0
	JNC exit			;condition check for whether 100ms are up
	SJMP  hundfifms_done
exit:
	POP AR2
	POP AR1
	RET
	
	
	ORG 000BH		
ISR0:
	CLR TR0
	RETI

END



ISR1:
	CLR 	TR1
	MOV		TH1, 	#0ffH
	MOV		TL1,	#0f0H
	
	CJNE	R7,		#00H, 	NOT0
	LJMP	IGNORE
	
	NOT0:
	CJNE	R7,		#0FH,	COMPARE
	COMPARE:
	JC		FORWARD
	
	REVERSE:
	CJNE	R6,		#00H,	R6INC
	LJMP	R6NINC
	
	R6INC:
	DJNZ	R6,		IGNORE
	
	R6NINC:
	MOV		A,		R7
	MOV		R7,		#0F8H
	SUBB	A,		R7
	MOV		R6,		A
	MOV		A,		OUT
	RR		A
	MOV		OUT,	A
	LJMP	IGNORE

	FORWARD:
	CJNE	R6,		#00H,	R6DEC
	LJMP	R6NDEC
	
	R6DEC:
	DJNZ	R6,		IGNORE
	
	R6NDEC:
	MOV		A,		#08H
	SUBB	A,		R7
	MOV		R6,		A
	MOV		A,		OUT
	RR		A
	MOV		OUT,	A
	LJMP	IGNORE
	

	IGNORE:
	SETB	TR0
	RETI
	